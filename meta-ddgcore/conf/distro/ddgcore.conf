## meta-ddgcore/conf/distro/ddgcore.conf
```bitbake
DISTRO = "ddgcore"
DISTRO_NAME = "DDoS Guard Core"
DISTRO_VERSION = "1.0"
MAINTAINER = "Penguins <penguins-dstu@yandex.ru>"

INIT_MANAGER = "systemd"

DISTRO_FEATURES:append = "pam ipsec keyboard"
DISTRO_FEATURES:remove = "x11 pulseaudio zeroconf alsa bluetooth"

IMAGE_FEATURES = " tools-sdk tools-debug package-management ssh-server-openssh"

IMAGE_INSTALL:append = " procps coreutils util-linux efibootmgr"
IMAGE_INSTALL:append = " sudo openssh openssl gnupg cronie"
IMAGE_INSTALL:append = " iptables iputils ppp curl"
IMAGE_INSTALL:append = " glibc-utils localedef"
IMAGE_INSTALL:append = " mdadm blktool"
IMAGE_INSTALL:append = " nano bash zip"
IMAGE_INSTALL:append = " python3 python3-pip"

ALTERNATIVE_PRIORITY[coreutils] = "30"
ALTERNATIVE_PRIORITY[procps] = "50"
ALTERNATIVE_PRIORITY[util-linux] = "70"
ALTERNATIVE_PRIORITY[busybox] = "100"

PREFERRED_VERSION_linux-yocto ?= "5.15%"
PREFERRED_VERSION_linux-yocto-rt ?= "5.15%"
PREFERRED_VERSION_python3 ?= "3.10%"

INHERIT += "extrausers"
EXTRA_USERS_PARAMS = "\
        usermod -p '$(openssl passwd ${ROOT_PASSWORD})' root; \
	useradd ${ADMIN_USERNAME}; \
        usermod -p '$(openssl passwd ${ADMIN_PASSWORD})' ${ADMIN_USERNAME}; \
	"

BB_SIGNATURE_HANDLER ?= "OEEquivHash"
BB_HASHSERVE ??= "auto"
```

## meta-ddgcore/conf/layer.conf
```bitbake
BBPATH .= ":${LAYERDIR}"

BBFILES += "${LAYERDIR}/recipes*/*/*.bb \
            ${LAYERDIR}/recipes*/*/*.bbappend"

BBFILE_COLLECTIONS += "ddgcore"
BBFILE_PATTERN_ddgcore = "^${LAYERDIR}/"

LAYERVERSION_ddgcore = "1"
LAYERSERIES_COMPAT_ddgcore = "kirkstone"
LAYERDEPENDS_ddgcore = "core"
```

## meta-ddgcore/conf/machine/include/x86/amd/amdx86.inc
```bitbake
PREFERRED_PROVIDER_virtual/kernel ?= "${@bb.utils.contains('RT_KERNEL_AMD', 'yes', 'linux-yocto-rt', 'linux-yocto', d)}"

require conf/machine/include/x86/amd/amd-common-configurations.inc

MACHINE_FEATURES:remove = "screen alsa"
MACHINE_EXTRA_RRECOMMENDS:remove = " rtc-test alsa-utils"

# Disable the graphical console when machine does not have a screen.
# This allows the serial console to be used for installation.
APPEND:remove="${@bb.utils.contains('MACHINE_FEATURES', 'screen-console', '', 'console=tty0', d)}"

MACHINEOVERRIDES =. "amd:amdx86:"
```

## meta-ddgcore/conf/machine/include/x86/amd/tune-zen2.inc
```bitbake
require conf/machine/include/x86/amd/tune-amd64.inc

TUNEVALID[zen2] = "Enable AMD x86 (64 bit) Zen 2 Core Architecture specific optimizations."
TUNE_CCARGS .= "${@bb.utils.contains('TUNE_FEATURES', 'zen2', ' -march=znver2', '', d)}"
TUNE_FEATURES:tune-amd64 = "m64 zen2"
```

## meta-ddgcore/conf/machine/zen2.conf
```bitbake
#@TYPE: Machine
#@NAME: Zen 2
#@DESCRIPTION: Machine configuration for AMD Zen 2 x86_64 (64-bit) architecture.

require conf/machine/include/x86/amd/tune-zen2.inc
require conf/machine/include/x86/amd/amdx86.inc
```

## templates/build/conf/bblayers.conf
```bitbake
# LAYER_CONF_VERSION is increased each time build/conf/bblayers.conf
# changes incompatibly
LCONF_VERSION = "7"

BBPATH = "${TOPDIR}"
BBFILES ?= ""

PROJECTROOT = "${@os.path.abspath(os.path.join('${TOPDIR}', os.pardir))}"

BBLAYERS ?= " \
  ${PROJECTROOT}/openembedded-core/meta \
  ${PROJECTROOT}/meta-yocto/meta-yocto-bsp \
  ${PROJECTROOT}/meta-ddgcore \
  "
```
